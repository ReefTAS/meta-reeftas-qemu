## meta-reeftas-qemux86/conf/machine/reeftas-qemux86.conf
```bitbake
#@TYPE: Machine
#@NAME: reeftas-qemux86

#@DESCRIPTION: Machine configuration for reeftas-qemux86 systems

PREFERRED_VERSION_linux-yocto ?= "4.10%"

PREFERRED_PROVIDER_virtual/bootloader ??= "u-boot"
PREFERRED_VERSION_u-boot = "2018.01"

UBOOT_SUFFIX="rom"
UBOOT_MACHINE="reeftas_qemux86_mmc_config"

IMAGE_BOOT_FILES ?= "u-boot.${UBOOT_SUFFIX}"

require conf/machine/include/qemu.inc
require conf/machine/include/tune-i586.inc
require conf/machine/include/qemuboot-x86.inc

#This machine will load kernel from rootfs /boot
RDEPENDS_kernel-base = "kernel-image"

MACHINE_FEATURES += "x86 pci"

MACHINE_ESSENTIAL_EXTRA_RDEPENDS += "v86d"

KERNEL_MODULE_AUTOLOAD += "uvesafb"
KERNEL_MODULE_PROBECONF += "uvesafb"
module_conf_uvesafb = "options uvesafb mode_option=${UVESA_MODE}"

KERNEL_IMAGETYPE = "bzImage"
SERIAL_CONSOLE = "115200 ttyS0"
XSERVER = "xserver-xorg \
           ${@bb.utils.contains('DISTRO_FEATURES', 'opengl', 'mesa-driver-swrast', '', d)} \
           xf86-video-vmware"

WKS_FILE = "reeftas.wks.in"
### wic default support
WKS_FILE_DEPENDS ?= " \
    virtual/bootloader \
    e2fsprogs-native \
    bmap-tools-native \
"

#var partition falls in extended partitions. Hence set the partition Number
#here.
REEFTAS_VAR_PART_NUMBER="5"

#Match alignment to sector size defined in wic
REEFTAS_PARTITION_ALIGNMENT_KB="512"
```

## meta-reeftas-qemux86/wic/sdimage-reeftas-qemu.wks
```
# short-description: Create a 'pcbios' direct disk image for reeftas
# long-description:
include reeftas.wks.inc
bootloader  --ptable msdos
```
